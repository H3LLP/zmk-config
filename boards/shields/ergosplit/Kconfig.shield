## boards/shields/ergosplit/Kconfig.shield
```kconfig
config SHIELD_ERGOSPLIT_LEFT
    def_bool $(shields_list_contains,ergosplit_left)
config SHIELD_ERGOSPLIT_RIGHT
    def_bool $(shields_list_contains,ergosplit_right)
config SHIELD_ERGOSPLIT_DONGLE
    def_bool $(shields_list_contains,ergosplit_dongle)
```
